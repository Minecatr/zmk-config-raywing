## config/boards/shields/raywing/Kconfig.defconfig
```kconfig
if SHIELD_RAYWING_LEFT

config ZMK_KEYBOARD_NAME
    default "Raywing"

config ZMK_SPLIT_ROLE_CENTRAL
    default y

endif

if SHIELD_RAYWING_LEFT || SHIELD_RAYWING_RIGHT

config ZMK_SPLIT
    default y

endif
```

## config/boards/shields/raywing/Kconfig.shield
```kconfig
config SHIELD_RAYWING_LEFT
    def_bool $(shields_list_contains, raywing_left)

config SHIELD_RAYWING_RIGHT
    def_bool $(shields_list_contains, raywing_right)
```
